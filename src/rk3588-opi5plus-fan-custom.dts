/dts-v1/;
/plugin/;

/ {
    compatible = "rockchip,rk3588-orangepi-5-plus";

    fragment@0 {
        target = <&pwm3>;
        __overlay__ {
            status = "okay";
            pinctrl-names = "active";
            pinctrl-0 = <&pwm3m1_pins>;
        };
    };

    fragment@1 {
        target = <&fan>;
        __overlay__ {
            status = "okay";
            pwms = <&pwm3 0 40000 0>;
            cooling-levels = <0 70 95 125 165 195 225 255>;
            rockchip,temp-trips = <
                55000 1
                57000 2
                59000 3
                63000 4
                67000 5
                71000 6
                75000 7
            >;
        };
    };
};
